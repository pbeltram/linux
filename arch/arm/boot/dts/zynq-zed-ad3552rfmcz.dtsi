&amba {
	axi_qspi: axi_quad_spi@70000000 {
		bits-per-word = <8>;
		//To check on dtsi
		clock-names = "ext_spi_clk s_axi_aclk";
		clocks = <&clkc 15>, <&clkc 15>;
		compatible = "xlnx,axi-quad-spi-3.2", "xlnx,xps-spi-2.00.a";
		fifo-size = <16>;
		interrupt-names = "ip2intc_irpt";
		interrupt-parent = <&intc>;
		interrupts = <0 57 1>;
		num-cs = <0x1>;
		reg = <0x70000000 0x1000>;
		xlnx,num-ss-bits = <0x1>;
		xlnx,spi-mode = <0>;
		
		ad3552r: ad3552r@0 {
			compatible = "adi,ad3552r";
			reg = <0x0>;
			spi-max-frequency = <20000000>;
		};
	};
};
/* Control GPIOs */
/*
		en_agc-gpios = <&gpio0 66 0>;
		reset-gpios = <&gpio0 67 0>;
*/
/*
leds {

	compatible = "gpio-leds";
	ld1 {
		label = "ld1:gpio6";
		gpios = <&gpio0 92 0>;
	};

	ld2 {
		label = "ld2:gpio6";
		gpios = <&gpio0 93 0>;
	};
	*/
/*
&qspi {
	is-dual = <0>;
	num-cs = <0x1>;
	spi-rx-bus-width = <1>;
	spi-tx-bus-width = <1>;
	status = "okay";	
	ad3552r: ad3552r@0 {
		compatible = "adi,ad3552r";
		spi-max-frequency = <20000000>;
	};
};
*/