## Documentation/devicetree/bindings/net/xilinx-phy.txt
```
Xilinx PCS/PMA PHY bindings

Required properties:
	- reg - The ID number for the phy, usually a small integer

Optional properties:
	- xlnx,phy-type - Describes type 1000BaseX (set to 0x5) or
			  SGMII (set to 0x4)
  - compatible - Id of Xilinx PCS/PMA PHY from PHY registers 2 and 3.
  - fixed-link - Disable auto-negotiation and set fixed link parameters.

Example:

	ethernet-phy@9 {
    compatible = "ethernet-phy-id0174.0c00";
		reg = <9>;
		xlnx,phy-type = <0x5>;
    fixed-link {
      speed = <1000>;
      full-duplex;
    };
	};
```

## Documentation/devicetree/bindings/rtc/ha1588.txt
~~~~
### Device Tree

The following is an example device tree segment generated by Xilinx's `device-tree-xlnx`
and patched with the compatibility string and `ha1588,period` property:

```
rtc_0: rtc@43c10000 {
    clock-names = "S_AXI_ACLK";
    clocks = <&misc_clk_2>;
    compatible = "ha1588,rtc-1.0";
    reg = <0x43c10000 0x10000>;
    ha1588,period = <0x19 0x00000000>;
};
```

The important properties are the `compatible` string name and `ha1588,period` key-value pair.

The `ha1588,period` is the the clock period for counting time in the HA1588 IP core.
It is 40 bits, nanoseconds, and set in firmware.
This property is for that initial value which will be updated by the kernel driver.
For example, a 40 MHz (25 ns) clock clock is: 

```
# Python: hex(int(25 * 2**32))
25.0 ns x 2^32 = 0x1900000000
~~~~

## drivers/aidpu/Kconfig
```kconfig
#
# AI DPU subsystem configuration
#

menuconfig AIDPU
	tristate "AI DPU support"
	help
	  AI DPU core drivers.

if AIDPU

source "drivers/aidpu/dpucma/Kconfig"
source "drivers/aidpu/dpu/Kconfig"

endif # AIDPU
```

## drivers/aidpu/dpu/Kconfig
```kconfig
#
# AI DPU core driver
#

menu "AI DPU driver"

config AIDPU_DPU
	tristate "Enable AI DPU driver"
	help
	 Say Y here to build AI DPU driver.

	 To compile this driver as module, choose M here: the
	 module will be called aidpu_dpu.

endmenu
```

## drivers/aidpu/dpucma/Kconfig
```kconfig
#
# DPU CMA driver
#

menu "DPU CMA driver"

config AIDPU_DPUCMA
	tristate "Enable DPU CMA driver"
	help
	 Say Y here to build DPU CMA driver.

	 To compile this driver as module, choose M here: the
	 module will be called aidpu_dpucma.

endmenu
```
